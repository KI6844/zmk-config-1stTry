## config/boards/shields/1stTRY/Kconfig.defconfig
```kconfig
if SHIELD_1stTRY_LEFT

config ZMK_KEYBOARD_NAME
    default "1stTRY"

config ZMK_SPLIT_ROLE_CENTRAL
    default y

endif

if SHIELD_1stTRY_LEFT || SHIELD_1stTRY_RIGHT

config ZMK_SPLIT
    default y

endif
```

## config/boards/shields/1stTRY/Kconfig.shield
```kconfig
config SHIELD_1stTRY_LEFT
    def_bool $(shields_list_contains,1stTRY_left)

config SHIELD_1stTRY_RIGHT
    def_bool $(shields_list_contains,1stTRY_right)
```
